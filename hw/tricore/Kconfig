## hw/tricore/Kconfig
```kconfig
config TRICORE_TESTBOARD
    default y
    depends on TRICORE
    bool

config TRIBOARD
    bool
    default y
    depends on TRICORE
    select TC27X_SOC

config TC27X_SOC
    bool

config TC397
    bool
    default y
    depends on TRICORE
    select TRICORE_ASCLIN
    select TRICORE_STM
    select TRICORE_IR
    select TRICORE_PORT
    select TC397_CAN
```
